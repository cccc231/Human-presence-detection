## rx/sdkconfig.defaults
```kconfig
CONFIG_IDF_TARGET="esp32s3"

# Enable WiFi CSI
CONFIG_ESP_WIFI_CSI_ENABLED=y

# SNTP
CONFIG_LWIP_SNTP_MAX_SERVERS=2

# Console UART
CONFIG_ESP_CONSOLE_UART_DEFAULT=y
CONFIG_ESP_CONSOLE_UART_BAUDRATE=115200

# FreeRTOS
CONFIG_FREERTOS_HZ=1000

# WiFi buffer tuning
CONFIG_ESP_WIFI_STATIC_RX_BUFFER_NUM=16
CONFIG_ESP_WIFI_DYNAMIC_RX_BUFFER_NUM=32
CONFIG_ESP_WIFI_RX_BA_WIN=6
```
